## Kconfig
```kconfig
config ZMK_BEHAVIOR_ENCODER_KEY_DIVIDER
    bool "Encoder key divider behavior"
    default y
    depends on DT_HAS_ZMK_BEHAVIOR_ENCODER_KEY_DIVIDER_ENABLED
    depends on !ZMK_SPLIT || ZMK_SPLIT_ROLE_CENTRAL
    help
      Forward every Nth consecutive encoder key event while resetting the
      partial count when the encoder direction changes.

config ZMK_INPUT_PROCESSOR_GESTURE
    bool "Gesture input processor"
    default y
    depends on DT_HAS_ZMK_INPUT_PROCESSOR_GESTURE_ENABLED
    help
      Enable the layer-aware pointing gesture input processor.
```

## config/west.yml
```yaml
manifest:
  remotes:
    - name: zmkfirmware
      url-base: https://github.com/zmkfirmware
  projects:
    - name: zmk
      remote: zmkfirmware
      revision: acfd8e5ea76cf23ad1c9b6b99848f97a95224257
      import: app/west.yml
    - name: zmk-pmw3610-driver
      url: https://github.com/takagitshi/roba-pmw3610-driver
      revision: 00b389b9093f89f7cec3e025126383877008acd1
  self:
    path: config
```

## dts/bindings/behaviors/zmk,behavior-encoder-key-divider.yaml
```yaml
# Copyright (c) 2026 Takashi Imai
# SPDX-License-Identifier: MIT

description: Encoder key divider behavior

compatible: "zmk,behavior-encoder-key-divider"

include: one_param.yaml

properties:
  bindings:
    type: phandles
    required: true
    description: Key behavior to forward after the configured number of encoder inputs

  divisor:
    type: int
    required: true
    description: Number of consecutive same-direction inputs required for one forwarded key event

  timeout-ms:
    type: int
    required: true
    description: Maximum time between consecutive same-direction inputs

  direction:
    type: int
    required: true
    description: Direction identifier used with shared state; paired directions must use distinct values
```
